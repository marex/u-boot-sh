## board/aries/m53evk/Kconfig
```kconfig
if TARGET_M53EVK

config SPL_BUILD
	default "u-boot-with-nand-spl.imx"

config SYS_BOARD
	default "m53evk"

config SYS_VENDOR
	default "aries"

config SYS_SOC
	default "mx5"

config SYS_CONFIG_NAME
	default "m53evk"

endif
```

## board/dhelectronics/dh_imx6/Kconfig
```kconfig
if TARGET_DHCOMIMX6

config SPL_BUILD
	default "u-boot-with-spl.imx"

config SYS_BOARD
	default "dh_imx6"

config SYS_VENDOR
	default "dhelectronics"

config SYS_CONFIG_NAME
	default "dh_imx6"

endif
```

## board/freescale/mx31pdk/Kconfig
```kconfig
if TARGET_MX31PDK

config SPL_BUILD
	default "u-boot-with-spl.bin"

config SPL_LDSCRIPT
	default "arch/$(ARCH)/cpu/u-boot-spl.lds"

config SYS_BOARD
	default "mx31pdk"

config SYS_VENDOR
	default "freescale"

config SYS_SOC
	default "mx31"

config SYS_CONFIG_NAME
	default "mx31pdk"

endif
```

## configs/sh7752evb_defconfig
```kconfig
CONFIG_SH=y
CONFIG_SYS_TEXT_BASE=0x5ff80000
CONFIG_SH_32BIT=y
CONFIG_TARGET_SH7752EVB=y
CONFIG_BOOTDELAY=3
CONFIG_USE_BOOTARGS=y
CONFIG_BOOTARGS="console=ttySC2,115200 root=/dev/nfs ip=dhcp"
CONFIG_VERSION_VARIABLE=y
# CONFIG_CMD_BDI is not set
# CONFIG_CMD_CONSOLE is not set
# CONFIG_CMD_BOOTD is not set
# CONFIG_CMD_IMI is not set
# CONFIG_CMD_XIMG is not set
# CONFIG_CMD_EDITENV is not set
# CONFIG_CMD_ENV_EXISTS is not set
CONFIG_CMD_MD5SUM=y
# CONFIG_CMD_FLASH is not set
# CONFIG_CMD_LOADB is not set
CONFIG_CMD_SDRAM=y
# CONFIG_CMD_ECHO is not set
# CONFIG_CMD_ITEST is not set
# CONFIG_CMD_SOURCE is not set
# CONFIG_CMD_SETEXPR is not set
# CONFIG_CMD_MISC is not set
CONFIG_SCIF_CONSOLE=y
CONFIG_USE_PRIVATE_LIBGCC=y
CONFIG_NR_DRAM_BANKS=1
CONFIG_DM=y
CONFIG_OF_LIBFDT=y
CONFIG_OF_CONTROL=y
CONFIG_OF_SEPARATE=y
CONFIG_DEFAULT_DEVICE_TREE="r8a7791-porter-u-boot"
CONFIG_SYS_MALLOC_F_LEN=0x8000
```
